## firmware/sdkconfig.defaults
```kconfig
# ESP32 flash configuration
CONFIG_ESPTOOLPY_FLASHSIZE_4MB=y

# Partition table: large single application, no OTA
CONFIG_PARTITION_TABLE_SINGLE_APP_LARGE=y

# External PSRAM configuration
CONFIG_SPIRAM=y
CONFIG_SPIRAM_MODE_QUAD=y
CONFIG_SPIRAM_TYPE_AUTO=y
CONFIG_SPIRAM_SPEED_40M=y
CONFIG_SPIRAM_BOOT_INIT=y
CONFIG_SPIRAM_USE_MALLOC=y
CONFIG_SPIRAM_MEMTEST=y
```
